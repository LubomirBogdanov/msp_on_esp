#include <stdint.h>
#include <msp430.h>

#include "picojpeg.h"

#include <string.h>

#define REPEAT_FACTOR   5
#define SCALE_FACTOR    (REPEAT_FACTOR >> 0)

const unsigned char jpeg_data[] = {
  0xff, 0xd8, 0xff, 0xe0, 0x00, 0x10, 0x4a, 0x46, 0x49, 0x46, 0x00, 0x01, 0x01, 0x01, 0x00, 0x48,
  0x00, 0x48, 0x00, 0x00, 0xff, 0xdb, 0x00, 0x43, 0x00, 0x50, 0x37, 0x3c, 0x46, 0x3c, 0x32, 0x50,
  0x46, 0x41, 0x46, 0x5a, 0x55, 0x50, 0x5f, 0x78, 0xc8, 0x82, 0x78, 0x6e, 0x6e, 0x78, 0xf5, 0xaf,
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  0x40, 0x74, 0xb8, 0x11, 0x06, 0x00, 0xb8, 0x1f, 0xff, 0xd9
};
unsigned jpeg_off = 0;

#define MIN(a,b) ((a)<(b)?(a):(b))

unsigned char pjpeg_need_bytes_callback(unsigned char* pBuf, unsigned char buf_size, unsigned char *pBytes_actually_read, void *pCallback_data){
  unsigned n = MIN(sizeof(jpeg_data) - jpeg_off, buf_size);

  memcpy(pBuf,&jpeg_data[jpeg_off],n);
  *pBytes_actually_read = (unsigned char)n;
  jpeg_off += n;
  return 0;
}

char get_char(void){
    while (!(UCA1IFG & UCRXIFG)) { }
    return UCA1RXBUF;
}

void put_char(char ch){
    while (!(UCA1IFG & UCTXIFG)) { }
    UCA1TXBUF = ch;
}

void display_msg(char *message){
    while(*message != '\0'){
        put_char(*(message++));
    }
}

int main(void){
    pjpeg_image_info_t pInfo;
    unsigned char status;
    char *start_msg = (char *)"Starting picojpeg algorithm ...";
    char *stop_msg = (char *)"end!\n\r";
    volatile uint16_t i;

    WDTCTL = WDTPW | WDTHOLD;

    P1DIR |= BIT0;

    P4SEL |= BIT4 | BIT5; // P4.4 = UCA1TXD, P4.5 = UCA1RXD
    UCA1CTL1 |= UCSWRST; //Hold in reset
    UCA1CTL1 |= UCSSEL_2; // SMCLK
    UCA1BR0 = 9; //1MHz <-> 115200
    UCA1BR1 = 0; //1MHz <-> 115200
    UCA1MCTL |= (UCBRS_1 | UCBRF_0); // Modulation UCBRSx=1, UCBRFx=0
    UCA1CTL1 &= ~UCSWRST; //Release from reset

    __disable_interrupt();

    while(1){
        P1OUT |= BIT0;
        display_msg(start_msg);

        jpeg_off = 0;

        status = pjpeg_decode_init(&pInfo, pjpeg_need_bytes_callback, 0, 0);

        while(1){
            status = pjpeg_decode_mcu();

            if(status == PJPG_NO_MORE_BLOCKS){
                break;
            }
        }

        display_msg(stop_msg);
        P1OUT &= ~BIT0;

        for(i = 0; i < 50000; i ++){ }
    }
}
